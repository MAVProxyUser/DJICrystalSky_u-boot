## configs/zs600a_defconfig
```kconfig
CONFIG_SYS_EXTRA_OPTIONS="RKCHIP_RK3288,PRODUCT_MID"
CONFIG_ARM=y
CONFIG_ROCKCHIP_ARCH32=y
CONFIG_PLAT_RK32XX=y
CONFIG_ROCKCHIP_POWER_SUPPLY=y
CONFIG_RK_UART_ZS600=y
CONFIG_DJI_ZS600A=y
```

## dts/Kconfig
```kconfig
#
# Device Tree Control
#
# TODO:
#   This feature is not currently supported for SPL,
#    but this restriction should be removed in the future.

config SUPPORT_OF_CONTROL
	bool
config ROCKCHIP_MOTOR
	bool "motor control"
config ROCKCHIP_POWER_SUPPLY
	bool "power supply"
config RK_UART_ZS600
	bool "uart zs600"
config DJI_ZS600A
	bool "board type dji zs600a"
config DJI_ZS600B
	bool "board type dji zs600b"
menu "Device Tree Control"
	depends on !SPL_BUILD
	depends on SUPPORT_OF_CONTROL

config OF_CONTROL
	bool "Run-time configuration via Device Tree"
	help
	  This feature provides for run-time configuration of U-Boot
	  via a flattened device tree.

config POWERKEY_INTO_LOADER
	bool "config define for power key press force into loader"
	help
	  This feature provides for config define for power key press force into loader.

config RECOVERY_KEY_ENABLE
	bool "define for recovery key"
	help 
	This feature provides for define for recovery key

config FASTBOOT_KEY_ENABLE
	bool "define for fastboot key"
	help 
	This feature provides for define for fastboot key

choice
	prompt "Provider of DTB for DT control"
	depends on OF_CONTROL

config OF_SEPARATE
	bool "Separate DTB for DT control"
	depends on !SANDBOX
	help
	  If this option is enabled, the device tree will be built and
	  placed as a separate u-boot.dtb file alongside the U-Boot image.

config OF_EMBED
	bool "Embedded DTB for DT control"
	help
	  If this option is enabled, the device tree will be picked up and
	  built into the U-Boot image.

config OF_HOSTFILE
	bool "Host filed DTB for DT control"
	depends on SANDBOX
	help
	  If this option is enabled, DTB will be read from a file on startup.
	  This is only useful for Sandbox.  Use the -d flag to U-Boot to
	  specify the file to read.

endchoice

config DEFAULT_DEVICE_TREE
	string "Default Device Tree for DT control"
	help
	  This option specifies the default Device Tree used for DT control.
	  It can be overrided from the command line:
	  $ make DEVICE_TREE=<device-tree-name>

endmenu
```
